## firmware/sync-mcu/boards/arc/arc_sync/board.yml
```yaml
board:
  name: arc_sync
  full_name: ARC sync board
  socs:
    - name: stm32h723xx
```

## firmware/sync-mcu/tests/can_command_core/testcase.yaml
```yaml
tests:
  sync_mcu.can_command_core:
    tags: safety
    platform_allow:
      - native_sim
    integration_platforms:
      - native_sim
```

## firmware/sync-mcu/tests/controller_link/testcase.yaml
```yaml
tests:
  sync_mcu.controller_link:
    platform_allow: native_sim
    tags: safety controller_link
    integration_platforms:
      - native_sim
```

## firmware/sync-mcu/tests/fault_latch/testcase.yaml
```yaml
tests:
  sync_mcu.fault_latch:
    tags: safety
    platform_allow:
      - native_sim
    integration_platforms:
      - native_sim
```

## firmware/sync-mcu/tests/rate_monitor/testcase.yaml
```yaml
tests:
  sync_mcu.rate_monitor:
    tags: monitor
    platform_allow:
      - native_sim
    integration_platforms:
      - native_sim
```

## firmware/sync-mcu/tests/safety/testcase.yaml
```yaml
tests:
  sync_mcu.safety:
    tags: safety
    platform_allow:
      - native_sim
    integration_platforms:
      - native_sim
```
